## 3rdparty/os/RT-Thread/Kconfig
```kconfig
mainmenu "RT-Thread Configuration"

config BSP_DIR
    string
    option env="BSP_ROOT"
    default "."

config RTT_DIR
    string
    option env="RTT_ROOT"
    default "rt-thread"

config PKGS_DIR
    string
    option env="PKGS_ROOT"
    default "packages"

source "$RTT_DIR/Kconfig"
source "$PKGS_DIR/Kconfig"


config RISCV_CORE
    bool
    select ARCH_RISCV
    select PKG_USING_NUCLEI_SDK
    select RT_USING_COMPONENTS_INIT
    select RT_USING_USER_MAIN
    # default y

config AARCH64_CORE
    bool
    select ARCH_ARMV8
    select ARCH_CPU_64BIT
    select RT_USING_COMPONENTS_INIT
    select RT_USING_USER_MAIN
    # default y


source "$BSP_DIR/board/Kconfig"
source "$BSP_DIR/utest/testcases/Kconfig"
```

## 3rdparty/os/RT-Thread/board/arm/Kconfig
```kconfig
menu "AARCH64 qemu virt64 configs"

    choice
        prompt "GIC Version"
        default BSP_USING_GICV2

        config BSP_USING_GICV2
            bool "GICv2"

        config BSP_USING_GICV3
            bool "GICv3"
    endchoice

endmenu
```

## 3rdparty/os/RT-Thread/utest/testcases/Kconfig
```kconfig
menu "RT-Thread Utestcases"

config RT_USING_UTESTCASES
    bool "RT-Thread Utestcases"
    default n
    select RT_USING_UTEST

if RT_USING_UTESTCASES

source "$BSP_DIR/utest/testcases/utest/Kconfig"
source "$BSP_DIR/utest/testcases/kernel/Kconfig"
source "$BSP_DIR/utest/testcases/cpp11/Kconfig"
source "$BSP_DIR/utest/testcases/drivers/serial_v2/Kconfig"
source "$BSP_DIR/utest/testcases/posix/Kconfig"

endif

endmenu
```
